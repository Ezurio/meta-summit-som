// SPDX-License-Identifier: (GPL-2.0-or-later OR MIT)
/*
 * Copyright 2026 Ezurio LLC
 */

#include "tungsten-mt8390-smarc-dsi0-7.dtso"

&panel_dsi0 {
	width-mm = <217>;
	height-mm = <136>;
};

&touchscreen_dsi0 {
	compatible = "goodix,gt9271";
};
