// SPDX-License-Identifier: (GPL-2.0+ OR MIT)
/*
 * On-board SDIO MT320 radio-only module
 */

/dts-v1/;
/plugin/;

&reg_wifi_en {
	startup-delay-us = <20000>;
	off-on-delay-us = <100>;
};

&mmc2 {
	status = "okay";
	cap-power-off-card;
	vmmc-supply = <&reg_wifi_en>;
};
