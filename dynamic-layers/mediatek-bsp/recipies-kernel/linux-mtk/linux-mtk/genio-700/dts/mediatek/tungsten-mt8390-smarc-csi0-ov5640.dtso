// SPDX-License-Identifier: (GPL-2.0+ OR MIT)
/*
 * Copyright (C) 2026 Ezurio LLC
 */

/dts-v1/;
/plugin/;

#include "tungsten-mt8390-smarc-csi0.dtsi"

&cam_csi0 {
	status = "okay";
	reg = <0x3c>;
	compatible = "ovti,ov5640";

	DOVDD-supply = <&reg_3v3>;
	AVDD-supply = <&reg_3v3>;
	DVDD-supply = <&reg_3v3>;

	reset-gpios = <&pio 19 GPIO_ACTIVE_LOW>;
	powerdown-gpios = <&pio 18 GPIO_ACTIVE_LOW>;
};
