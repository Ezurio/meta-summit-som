// SPDX-License-Identifier: (GPL-2.0+ OR MIT)
/*
 * ArduCam Pivariety camera module
 *
 * Copyright (C) 2026 Ezurio LLC
 */

/dts-v1/;
/plugin/;

#include "tungsten-mt8390-smarc-csi1.dtsi"

&cam_csi1 {
	status = "okay";
	reg = <0x0c>;
	compatible = "arducam,arducam-pivariety";

	VANA-supply = <&reg_3v3>;
	VDIG-supply = <&reg_3v3>;
	VDDL-supply = <&reg_3v3>;

	reset-gpios = <&pio 21 GPIO_ACTIVE_HIGH>;
	enable-gpios = <&pio 20 GPIO_ACTIVE_HIGH>;
};

&cam_csi1_ep {
	data-lanes = <1 2 3 4>;
};

&seninf_csi1_in_ep {
	data-lanes = <1 2 3 4>;
};
