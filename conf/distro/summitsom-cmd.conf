## conf/machine/imx91-nitrogen-osm-m.conf
```bitbake
#@TYPE: Machine
#@NAME: Nitrogen i.MX91 OSM-M
#@SOC: i.MX91
#@DESCRIPTION: Machine configuration for Nitrogen i.MX91 OSM-M module
#@MAINTAINER: Boris Krasnovskiy <Boris.Krasnovskiy@ezurio.com>

require conf/machine/include/imx91-nitrogen.inc

MACHINEOVERRIDES =. "summitsom_osm:"

KERNEL_DEVICETREE_BASENAME = "nitrogen-imx91-osm-m"

KERNEL_DEVICETREE = " \
    freescale/nitrogen-imx91-osm-m-dvk.dtb \
    freescale/nitrogen-imx91-osm-m-m2-60-sdio-sdio.dtbo \
    freescale/nitrogen-imx91-osm-m-m2-60-sdio-uart.dtbo \
    freescale/nitrogen-imx91-osm-m-m2-ifx-sdio.dtbo \
    freescale/nitrogen-imx91-osm-m-m2-nx6xx-sdio.dtbo \
    freescale/nitrogen-imx91-osm-m-m2-ti3xx-sdio.dtbo \
    freescale/nitrogen-imx91-osm-m-m2-usb.dtbo \
    freescale/nitrogen-imx91-osm-m-wifi-ifx.dtbo \
    freescale/nitrogen-imx91-osm-m-wifi-nx6xx.dtbo \
    freescale/nitrogen-imx91-osm-m-wifi-ti3xx.dtbo \
"

FIT_CONF_DEFAULT_DTB = "nitrogen-imx91-osm-m-dvk.dtb"

UBOOT_MACHINE = "nitrogen_imx91_osm_m_defconfig"

SUMMIT_SOM_RADIO_TYPE ?= "dvk-combo"
BT_SERIAL_PORT = "/dev/ttyLP4"
```

## conf/machine/imx91-nitrogen-osm-s.conf
```bitbake
#@TYPE: Machine
#@NAME: Nitrogen i.MX91 OSM-S
#@SOC: i.MX91
#@DESCRIPTION: Machine configuration for Nitrogen i.MX91 OSM-S module
#@MAINTAINER: Boris Krasnovskiy <Boris.Krasnovskiy@ezurio.com>

require conf/machine/include/imx91-nitrogen.inc

MACHINEOVERRIDES =. "summitsom_osm:"

KERNEL_DEVICETREE_BASENAME = "nitrogen-imx91-osm-s"

KERNEL_DEVICETREE = " \
    freescale/nitrogen-imx91-osm-s-dvk.dtb \
    freescale/nitrogen-imx91-osm-s-m2-60-sdio-sdio.dtbo \
    freescale/nitrogen-imx91-osm-s-m2-60-sdio-uart.dtbo \
    freescale/nitrogen-imx91-osm-s-m2-ifx-sdio.dtbo \
    freescale/nitrogen-imx91-osm-s-m2-nx6xx-sdio.dtbo \
    freescale/nitrogen-imx91-osm-s-m2-ti3xx-sdio.dtbo \
    freescale/nitrogen-imx91-osm-s-wifi-ifx.dtbo \
    freescale/nitrogen-imx91-osm-s-wifi-nx6xx.dtbo \
    freescale/nitrogen-imx91-osm-s-wifi-ti3xx.dtbo \
"

FIT_CONF_DEFAULT_DTB = "nitrogen-imx91-osm-s-dvk.dtb"

UBOOT_MACHINE = "nitrogen_imx91_osm_s_defconfig"

SUMMIT_SOM_RADIO_TYPE ?= "dvk-combo"
BT_SERIAL_PORT = "/dev/ttyLP3"
```

## conf/machine/imx91-nitrogen-smarc.conf
```bitbake
#@TYPE: Machine
#@NAME: Nitrogen i.MX91 SMARC
#@SOC: i.MX91
#@DESCRIPTION: Machine configuration for Nitrogen i.MX91 SMARC module
#@MAINTAINER: Boris Krasnovskiy <Boris.Krasnovskiy@ezurio.com>

require conf/machine/include/imx91-nitrogen.inc

MACHINEOVERRIDES =. "summitsom_smarc:"

KERNEL_DEVICETREE_BASENAME = "nitrogen-imx91-smarc"

KERNEL_DEVICETREE = " \
    freescale/nitrogen-imx91-smarc-dvk.dtb \
    freescale/nitrogen-imx91-smarc-m2-60-sdio-sdio.dtbo \
    freescale/nitrogen-imx91-smarc-m2-60-sdio-uart.dtbo \
    freescale/nitrogen-imx91-smarc-m2-ifx-sdio.dtbo \
    freescale/nitrogen-imx91-smarc-m2-nx6xx-sdio.dtbo \
    freescale/nitrogen-imx91-smarc-m2-ti3xx-sdio.dtbo \
    freescale/nitrogen-imx91-smarc-wifi-ifx.dtbo \
    freescale/nitrogen-imx91-smarc-wifi-nx6xx.dtbo \
    freescale/nitrogen-imx91-smarc-wifi-ti3xx.dtbo \
"

FIT_CONF_DEFAULT_DTB = "nitrogen-imx91-smarc-dvk.dtb"

UBOOT_MACHINE = "nitrogen_imx91_smarc_defconfig"

SUMMIT_SOM_RADIO_TYPE ?= "dvk-combo"
BT_SERIAL_PORT = "/dev/ttyLP7"
```
