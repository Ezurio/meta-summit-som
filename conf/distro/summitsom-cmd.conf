## conf/distro/summitsom-cmd.conf
```bitbake
require conf/distro/poky.conf

DISTRO = "summitsom-cmd"
DISTRO_NAME = "Summit SOM Command Line"

INIT_MANAGER = "systemd"

DISTRO_FEATURES_DEFAULTS = "lto"

DISTRO_FEATURES = "\
    usrmerge \
    largefile \
    xattr \
    ipv4 \
    ipv6 \
    systemd \
    ${@bb.utils.filter('MACHINE_FEATURES', 'alsa usbhost usbgadget', d)} \
    ${@bb.utils.contains('BBFILE_COLLECTIONS', 'summit-radio', 'wifi bluetooth', '', d)} \
    "

VIRTUAL-RUNTIME_syslog = ""
VIRTUAL-RUNTIME_base-utils-syslog = ""
VIRTUAL-RUNTIME_base-utils-hwclock = "util-linux-hwclock"

#NO_RECOMMENDATIONS = "1"

GLIBC_GENERATE_LOCALES = "C.UTF-8 en_US.UTF-8"
IMAGE_LINGUAS = "en-us"

SELECTED_OPTIMIZATION = "-Os -pipe ${DEBUG_LEVELFLAG}"

PACKAGE_CLASSES:summitsom ?= "package_ipk"

PACKAGECONFIG:remove:pn-modemmanager = "vala"

FILESYSTEM_PERMS_TABLES:remove = "files/fs-perms-volatile-log.txt"
```

## conf/distro/summitsom-mfg-initramfs.conf
```bitbake
require summitsom-mfg.conf

DISTRO = "summitsom-mfg-initramfs"
DISTRO_NAME = "Summit SOM Manufacturing Initramfs"

INITRAMFS_IMAGE = "image-summitsom-mfg-initramfs"
FIT_EXTERNAL_DTB_OVERLAYS = "1"

DISTROOVERRIDES .= ":summitsom-initramfs:summitsom-usb-boot:summitsom-mfg"
```

## conf/distro/summitsom-mfg.conf
```bitbake
require conf/distro/poky.conf

DISTRO = "summitsom-mfg"
DISTRO_NAME = "Summit SOM Manufacturing and Regulatory Compliance Testing"

INIT_MANAGER = "sysvinit"

DISTRO_FEATURES_DEFAULTS = "lto"

DISTRO_FEATURES = "\
    usrmerge \
    largefile \
    xattr \
    ipv4 \
    ipv6 \
    alsa \
    usbhost \
    usbgadget \
    ${@bb.utils.contains('BBFILE_COLLECTIONS', 'summit-radio', 'wifi bluetooth', '', d)} \
    "

VIRTUAL-RUNTIME_init_manager = "busybox"

NO_RECOMMENDATIONS = "1"

GLIBC_GENERATE_LOCALES = " "
IMAGE_LINGUAS = " "

SELECTED_OPTIMIZATION = "-Os -pipe ${DEBUG_LEVELFLAG}"

PACKAGE_CLASSES:summitsom ?= "package_ipk"
```

## conf/distro/summitsom-rescue-initramfs.conf
```bitbake
require summitsom-rescue.conf

DISTRO = "summitsom-rescue-initramfs"
DISTRO_NAME = "Summit SOM Rescue Initramfs"

INITRAMFS_IMAGE = "image-summitsom-rescue-initramfs"
FIT_EXTERNAL_DTB_OVERLAYS = "0"

DISTROOVERRIDES .= ":summitsom-initramfs:summitsom-usb-boot:summitsom-rescue"
```

## conf/distro/summitsom-rescue.conf
```bitbake
require conf/distro/poky.conf

DISTRO = "summitsom-rescue"
DISTRO_NAME = "Summit SOM SD card Rescue"

INIT_MANAGER = "sysvinit"

DISTRO_FEATURES_DEFAULTS = "lto"

DISTRO_FEATURES = "\
    usrmerge \
    largefile \
    xattr \
    ipv4 \
    ipv6 \
    usbgadget \
    "

VIRTUAL-RUNTIME_init_manager = "busybox"

NO_RECOMMENDATIONS = "1"

GLIBC_GENERATE_LOCALES = " "
IMAGE_LINGUAS = " "

SELECTED_OPTIMIZATION = "-Os -pipe ${DEBUG_LEVELFLAG}"

PACKAGE_CLASSES:summitsom ?= "package_ipk"
```

## conf/distro/summitsom-secure.inc
```bitbake
DISTRO .= "-secure"
DISTRO_NAME .= " Secure"

DISTROOVERRIDES .= ":summit-secure"

require conf/distro/include/no-gplv3.inc
```

## conf/distro/summitsom-wayland.conf
```bitbake
require summitsom-cmd.conf

DISTRO = "summitsom-wayland"
DISTRO_NAME = "Summit SOM Wayland"

DISTRO_FEATURES += "opengl vulkan wayland pam"

# Prefer the Scarthgap/NXP versions on i.MX; Summit machine includes select
# the newer stack for Genio and Carbon machines.
PREFERRED_VERSION_hwdata:imx-nxp-bsp ??= "0.381"
PREFERRED_VERSION_hwdata:mx6-nxp-bsp ??= "0.381"
PREFERRED_VERSION_hwdata:mx7-nxp-bsp ??= "0.381"
PREFERRED_VERSION_wayland:imx-nxp-bsp ??= "1.22.0"
PREFERRED_VERSION_wayland:mx6-nxp-bsp ??= "1.22.0"
PREFERRED_VERSION_wayland:mx7-nxp-bsp ??= "1.22.0"
PREFERRED_VERSION_wayland-native:imx-nxp-bsp ??= "1.22.0"
PREFERRED_VERSION_wayland-native:mx6-nxp-bsp ??= "1.22.0"
PREFERRED_VERSION_wayland-native:mx7-nxp-bsp ??= "1.22.0"
PREFERRED_VERSION_wayland-protocols:mx6-nxp-bsp ??= "1.32.imx"
PREFERRED_VERSION_wayland-protocols:mx7-nxp-bsp ??= "1.32.imx"
PREFERRED_VERSION_wayland-utils:imx-nxp-bsp ??= "1.2.0"
PREFERRED_VERSION_wayland-utils:mx6-nxp-bsp ??= "1.2.0"
PREFERRED_VERSION_wayland-utils:mx7-nxp-bsp ??= "1.2.0"
```

## conf/layer.conf
```bitbake
# We have a conf and classes directory, add to BBPATH
BBPATH =. "${LAYERDIR}:"

# We have recipes-* directories, add to BBFILES
BBFILES += " \
    ${LAYERDIR}/recipes-*/*/*.bb \
    ${LAYERDIR}/recipes-*/*/*.bbappend \
    "

RFPROS_FILESHARE_AUTH ?= ""

BBFILE_COLLECTIONS += "summit-som"
BBFILE_PATTERN_summit-som = "^${LAYERDIR}/"
BBFILE_PRIORITY_summit-som = "9"

LAYERSERIES_COMPAT_summit-som = "wrynose"

SUMMIT_SOM_KEYS_DIR = "${LAYERDIR}/keys"

SUMMIT_SOM_LAYERDIR = "${LAYERDIR}"

CLOUD_HSM_BACKEND ??= "${@'aws-kms' if any(d.getVar(v) for v in ('AWS_KMS_KEY_ARN', 'AWS_KMS_CSF_KEY_ARN', 'AWS_KMS_IMG_KEY_ARN', 'AWS_KMS_FIT_KEY_ARN', 'AWS_KMS_AHAB_KEY_ARN', 'AWS_KMS_UPDATE_KEY_ARN')) else ''}"
CLOUD_HSM_BACKENDS = "aws-kms"

LICENSE_PATH += "${LAYERDIR}/licenses"

BBFILES_DYNAMIC += " \
    fsl-bsp-release:${LAYERDIR}/dynamic-layers/imx-bsp/recipes-*/*/*.bb \
    fsl-bsp-release:${LAYERDIR}/dynamic-layers/imx-bsp/recipes-*/*/*.bbappend \
    meta-ti-bsp:${LAYERDIR}/dynamic-layers/ti-bsp/recipes-*/*/*.bb \
    meta-ti-bsp:${LAYERDIR}/dynamic-layers/ti-bsp/recipes-*/*/*.bbappend \
    summit-radio:${LAYERDIR}/dynamic-layers/summit-radio/recipes-*/*/*.bb \
    summit-radio:${LAYERDIR}/dynamic-layers/summit-radio/recipes-*/*/*.bbappend \
    meta-aws:${LAYERDIR}/dynamic-layers/aws/recipes-*/*/*.bb \
    meta-aws:${LAYERDIR}/dynamic-layers/aws/recipes-*/*/*.bbappend \
    "

BBMASK += " \
    meta-imx-bsp/recipes-core/systemd/systemd_%.bbappend \
    meta-imx-bsp/recipes-core/psplash \
    meta-imx-sdk/recipes-core/systemd \
    "
```

## conf/machine/am62-carbon.conf
```bitbake
#@TYPE: Machine
#@NAME: AM62X CARBON
#@DESCRIPTION: Machine configuration for the AM62X CARBON

require conf/machine/include/am62xx.inc
require conf/machine/include/am6xx-carbon.inc

MACHINEOVERRIDES =. "summitsom_osm:"

SUMMIT_DEVICE_TREE_FILES = " \
        k3-am625-carbon-dvk.dts \
        k3-am625-carbon-csi-a-ov5640.dtso \
        k3-am625-carbon-csi-a-ov5645.dtso \
        k3-am625-carbon-csi-a-pivariety.dtso \
        k3-am625-carbon-lvds-d-10.dtso \
        k3-am625-carbon-lvds-d-7.dtso \
        k3-am625-carbon-lvds-d-hdmi.dtso \
        k3-am625-carbon-lvds-e-hdmi.dtso \
        k3-am625-carbon-m2-60-sdio-sdio.dtso \
        k3-am625-carbon-m2-60-sdio-uart.dtso \
        k3-am625-carbon-m2-ifx-sdio.dtso \
        k3-am625-carbon-m2-nx6xx-sdio.dtso \
        k3-am625-carbon-m2-ti3xx-sdio.dtso \
        k3-am625-carbon-m2-usb.dtso \
        k3-am625-carbon-mcu.dtso \
        k3-am625-carbon-rgb-hdmi.dtso \
        k3-am625-carbon-rgb-lvds-10.dtso \
        k3-am625-carbon-rgb-lvds-7.dtso \
        k3-am625-carbon-wifi-60-sdio-sdio.dtso \
        k3-am625-carbon-wifi-60-sdio-uart-stop.dtso \
        k3-am625-carbon-wifi-60-sdio-uart.dtso \
        k3-am625-carbon-wifi-60v1.dtso \
        k3-am625-carbon-wifi-ifx.dtso \
        k3-am625-carbon-wifi-nx6xx.dtso \
        k3-am625-carbon-wifi-ti3xx.dtso \
"

FIT_CONF_DEFAULT_DTB = "k3-am625-carbon-dvk.dtb"

UBOOT_MACHINE = "carbon_am62_a53_defconfig"

SUMMIT_SOM_RADIO_TYPE ?= "dvk-combo"
```

## conf/machine/am62l-carbon-emmc.conf
```bitbake
#@TYPE: Machine
#@NAME: AM62LX CARBON
#@DESCRIPTION: Machine configuration for the AM62LX CARBON eMMC

require conf/machine/include/am62lxx.inc
require conf/machine/include/am62lx-carbon.inc

MACHINEOVERRIDES =. "summitsom_osm:"

MACHINE_FEATURES:remove = "nand"

KERNEL_DEVICETREE = " \
    ti/k3-am62l-carbon-dvk_emmc.dtb \
    ti/k3-am62l-carbon-dsi-a-10.dtbo \
    ti/k3-am62l-carbon-dsi-a-7.dtbo \
    ti/k3-am62l-carbon-m2-60-sdio-sdio.dtbo \
    ti/k3-am62l-carbon-m2-60-sdio-uart.dtbo \
    ti/k3-am62l-carbon-m2-ifx-sdio.dtbo \
    ti/k3-am62l-carbon-m2-nx6xx-sdio.dtbo \
    ti/k3-am62l-carbon-m2-ti3xx-sdio.dtbo \
    ti/k3-am62l-carbon-m2-usb.dtbo \
    ti/k3-am62l-carbon-wifi-ifx.dtbo \
    ti/k3-am62l-carbon-wifi-nx6xx.dtbo \
    ti/k3-am62l-carbon-wifi-ti3xx.dtbo \
    "

FIT_CONF_DEFAULT_DTB = "k3-am62l-carbon-dvk_emmc.dtb"

UBOOT_MACHINE = "carbon_am62l_emmc_defconfig"

SUMMIT_SOM_RADIO_TYPE ?= "dvk-combo"
```

## conf/machine/am62l-carbon.conf
```bitbake
#@TYPE: Machine
#@NAME: AM62LX CARBON
#@DESCRIPTION: Machine configuration for the AM62LX CARBON

require conf/machine/include/am62lxx.inc
require conf/machine/include/am62lx-carbon.inc

MACHINEOVERRIDES:append = ":summitsom_osm:am62lx-nand"

KERNEL_DEVICETREE = " \
    ti/k3-am62l-carbon-dvk.dtb \
    ti/k3-am62l-carbon-dsi-a-10.dtbo \
    ti/k3-am62l-carbon-dsi-a-7.dtbo \
    ti/k3-am62l-carbon-m2-60-sdio-sdio.dtbo \
    ti/k3-am62l-carbon-m2-60-sdio-uart.dtbo \
    ti/k3-am62l-carbon-m2-ifx-sdio.dtbo \
    ti/k3-am62l-carbon-m2-nx6xx-sdio.dtbo \
    ti/k3-am62l-carbon-m2-ti3xx-sdio.dtbo \
    ti/k3-am62l-carbon-m2-usb.dtbo \
    ti/k3-am62l-carbon-wifi-ifx.dtbo \
    ti/k3-am62l-carbon-wifi-nx6xx.dtbo \
    ti/k3-am62l-carbon-wifi-ti3xx.dtbo \
    "

FIT_CONF_DEFAULT_DTB = "k3-am62l-carbon-dvk.dtb"

UBOOT_MACHINE = "carbon_am62l_defconfig"

SUMMIT_SOM_RADIO_TYPE ?= "dvk-combo"
```

## conf/machine/am67-carbon.conf
```bitbake
#@TYPE: Machine
#@NAME: AM67 CARBON
#@DESCRIPTION: Machine configuration for the AM67 CARBON

require conf/machine/include/j722s.inc
require conf/machine/include/am6xx-carbon.inc

MACHINEOVERRIDES =. "summitsom_osm:"

MACHINE_FEATURES += "pci"

SUMMIT_DEVICE_TREE_FILES = " \
        k3-am675-carbon-dvk.dts \
        k3-am675-carbon-csi-a-ov5640.dtso \
        k3-am675-carbon-csi-a-ov5645.dtso \
        k3-am675-carbon-csi-a-pivariety.dtso \
        k3-am675-carbon-csi-b-ov5640.dtso \
        k3-am675-carbon-csi-b-ov5645.dtso \
        k3-am675-carbon-csi-b-pivariety.dtso \
        k3-am675-carbon-csi-c-ov5640.dtso \
        k3-am675-carbon-csi-c-ov5645.dtso \
        k3-am675-carbon-csi-c-pivariety.dtso \
        k3-am675-carbon-csi-d-ov5640.dtso \
        k3-am675-carbon-csi-d-ov5645.dtso \
        k3-am675-carbon-csi-d-pivariety.dtso \
        k3-am675-carbon-dsi-a-10.dtso \
        k3-am675-carbon-dsi-a-7.dtso \
        k3-am675-carbon-dsi-a-hdmi.dtso \
        k3-am675-carbon-lvds-d-10.dtso \
        k3-am675-carbon-lvds-d-7.dtso \
        k3-am675-carbon-lvds-d-hdmi.dtso \
        k3-am675-carbon-lvds-e-10.dtso \
        k3-am675-carbon-lvds-e-7.dtso \
        k3-am675-carbon-lvds-e-hdmi.dtso \
        k3-am675-carbon-m2-60-pcie-uart.dtso \
        k3-am675-carbon-m2-60-sdio-sdio.dtso \
        k3-am675-carbon-m2-60-sdio-uart.dtso \
        k3-am675-carbon-m2-ifx-pcie.dtso \
        k3-am675-carbon-m2-ifx-sdio.dtso \
        k3-am675-carbon-m2-nx6xx-sdio.dtso \
        k3-am675-carbon-m2-ti3xx-sdio.dtso \
        k3-am675-carbon-wifi-ifx.dtso \
        k3-am675-carbon-wifi-nx6xx.dtso \
        k3-am675-carbon-wifi-ti3xx.dtso \
"

FIT_CONF_DEFAULT_DTB = "k3-am675-carbon-dvk.dtb"

UBOOT_MACHINE = "carbon_am67_a53_defconfig"

SUMMIT_SOM_RADIO_TYPE ?= "dvk-combo"
```

## conf/machine/imx8mm-nitrogen-smarc-2g.conf
```bitbake
#@TYPE: Machine
#@NAME: Nitrogen SMARC i.MX8M Mini 2GB
#@SOC: i.MX8
#@DESCRIPTION: Machine configuration for Nitrogen SMARC i.MX8M Mini 2GB
#@MAINTAINER: Boris Krasnovskiy <Boris.Krasnovskiy@ezurio.com>

require conf/machine/include/imx8mm-nitrogen.inc

MACHINEOVERRIDES =. "summitsom_smarc:"

SUMMIT_DEVICE_TREE_FILES = " \
        nitrogen-imx8mm-smarc-dvk.dts \
        nitrogen-imx8mm-smarc-csi1-ov5640.dtso \
        nitrogen-imx8mm-smarc-csi1-ov5645.dtso \
        nitrogen-imx8mm-smarc-csi1-pivariety.dtso \
        nitrogen-imx8mm-smarc-dsi0-10.dtso \
        nitrogen-imx8mm-smarc-dsi0-7.dtso \
        nitrogen-imx8mm-smarc-lvds0-10.dtso \
        nitrogen-imx8mm-smarc-lvds0-7.dtso \
        nitrogen-imx8mm-smarc-m2-60-sdio-sdio.dtso \
        nitrogen-imx8mm-smarc-m2-60-sdio-uart.dtso \
        nitrogen-imx8mm-smarc-m2-ifx-sdio.dtso \
        nitrogen-imx8mm-smarc-m2-nx6xx-sdio.dtso \
        nitrogen-imx8mm-smarc-m2-pcie.dtso \
        nitrogen-imx8mm-smarc-m2-ti3xx-sdio.dtso \
        nitrogen-imx8mm-smarc-mcu.dtso \
        nitrogen-imx8mm-smarc-wifi-ifx.dtso \
        nitrogen-imx8mm-smarc-wifi-nx6xx.dtso \
        nitrogen-imx8mm-smarc-wifi-ti3xx.dtso \
"

FIT_CONF_DEFAULT_DTB = "nitrogen-imx8mm-smarc-dvk.dtb"

UBOOT_MACHINE = "nitrogen_imx8mm_2g_defconfig"

SUMMIT_SOM_RADIO_TYPE ?= "dvk-combo"
BT_SERIAL_PORT = "/dev/ttymxc0"
```

## conf/machine/imx8mp-nitrogen-smarc-2g-r2.conf
```bitbake
#@TYPE: Machine
#@NAME: Nitrogen i.MX8M Plus 2GB Rev 2
#@SOC: i.MX8MP
#@DESCRIPTION: Machine configuration for Nitrogen i.MX8M Plus 2GB Rev 2
#@MAINTAINER: Boris Krasnovskiy <Boris.Krasnovskiy@ezurio.com>

require conf/machine/include/imx8mp-nitrogen.inc

MACHINEOVERRIDES =. "summitsom_smarc:"

SUMMIT_DEVICE_TREE_FILES = " \
        nitrogen-imx8mp-smarc-dvk.dts \
        nitrogen-imx8mp-smarc-csi0-ov5640.dtso \
        nitrogen-imx8mp-smarc-csi0-ov5645.dtso \
        nitrogen-imx8mp-smarc-csi0-pivariety.dtso \
        nitrogen-imx8mp-smarc-csi1-ov5640.dtso \
        nitrogen-imx8mp-smarc-csi1-ov5645.dtso \
        nitrogen-imx8mp-smarc-csi1-pivariety.dtso \
        nitrogen-imx8mp-smarc-dsi0-10.dtso \
        nitrogen-imx8mp-smarc-dsi0-7.dtso \
        nitrogen-imx8mp-smarc-dsp.dtso \
        nitrogen-imx8mp-smarc-hdmi.dtso \
        nitrogen-imx8mp-smarc-lvds0-10.dtso \
        nitrogen-imx8mp-smarc-lvds0-7.dtso \
        nitrogen-imx8mp-smarc-lvds1-10.dtso \
        nitrogen-imx8mp-smarc-lvds1-7.dtso \
        nitrogen-imx8mp-smarc-m2-60-sdio-sdio.dtso \
        nitrogen-imx8mp-smarc-m2-60-sdio-uart.dtso \
        nitrogen-imx8mp-smarc-m2-ifx-sdio.dtso \
        nitrogen-imx8mp-smarc-m2-nx6xx-sdio.dtso \
        nitrogen-imx8mp-smarc-m2-pcie.dtso \
        nitrogen-imx8mp-smarc-m2-ti3xx-sdio.dtso \
        nitrogen-imx8mp-smarc-mcu.dtso \
        nitrogen-imx8mp-smarc-wifi-ifx.dtso \
        nitrogen-imx8mp-smarc-wifi-nx6xx.dtso \
        nitrogen-imx8mp-smarc-wifi-ti3xx.dtso \
"

FIT_CONF_DEFAULT_DTB = "nitrogen-imx8mp-smarc-dvk.dtb"

UBOOT_MACHINE = "nitrogen_imx8mp_2g_r2_defconfig"

SUMMIT_SOM_RADIO_TYPE ?= "dvk-combo"
BT_SERIAL_PORT = "/dev/ttymxc3"
```

## conf/machine/imx8mp-summitsom.conf
```bitbake
#@TYPE: Machine
#@NAME: Summit SOM i.MX8M Plus
#@SOC: i.MX8MP
#@DESCRIPTION: Machine configuration for Summit SOM i.MX8M Plus
#@MAINTAINER: Boris Krasnovskiy <Boris.Krasnovskiy@ezurio.com>

require conf/machine/include/imx8mp-summitsom.inc

SUMMIT_DEVICE_TREE_FILES = " \
        imx8mp-summitsom-dvk.dts \
        imx8mp-summitsom-dsp.dtso \
        imx8mp-summitsom-hdmi.dtso \
        imx8mp-summitsom-lvds-bridge.dtso \
        imx8mp-summitsom-mcu.dtso \
        imx8mp-summitsom-mipi-bridge.dtso \
        imx8mp-summitsom-mipi-rm67191.dtso \
        imx8mp-summitsom-mipi-rm67199.dtso \
        imx8mp-summitsom-wifi-pcie-uart.dtso \
        imx8mp-summitsom-wifi-sdio-sdio.dtso \
        imx8mp-summitsom-wifi-sdio-uart-stop.dtso \
        imx8mp-summitsom-wifi-sdio-uart-susp.dtso \
        imx8mp-summitsom-wifi-sdio-uart.dtso \
"

FIT_CONF_DEFAULT_DTB = "imx8mp-summitsom-dvk.dtb"

UBOOT_MACHINE = "summitsom_imx8mp_defconfig"
```
