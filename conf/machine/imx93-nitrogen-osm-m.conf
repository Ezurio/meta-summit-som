## conf/machine/include/imx95-nitrogen.inc
```bitbake
#@TYPE: Machine
#@NAME: Nitrogen i.MX95
#@SOC: i.MX95
#@DESCRIPTION: Machine configuration for Nitrogen i.MX95
#@MAINTAINER: Boris Krasnovskiy <Boris.Krasnovskiy@ezurio.com>

MACHINEOVERRIDES =. "mx95:summitsom:ahab:"

require conf/machine/include/imx-base.inc
require conf/machine/include/arm/armv8-2a/tune-cortexa55.inc

# for better sstate cache reuse
DEFAULTTUNE:mx95-generic-bsp = "armv8a-crc-crypto"

require conf/machine/include/u-boot-summit.inc
include ${@bb.utils.contains('BBFILE_COLLECTIONS', 'summit-radio', 'conf/machine/include/radio-stack.inc', '', d)}

MACHINE_FEATURES = "pci usbgadget usbhost alsa rtc optee screen touchscreen wifi bluetooth camera"
MACHINE_FEATURES:append:use-nxp-bsp = " dpdk"

SOC_DEFAULT_IMAGE_FSTYPES = ""

IMAGE_BOOT_FILES = "uboot.env"
SWUPDATE_IMAGES = "flash.bin uboot.env"

UBOOT_PROVIDES_BOOT_CONTAINER = "1"
IMX_DEFAULT_BOOTLOADER:mx9-generic-bsp = "u-boot-imx-summit"
IMX_DEFAULT_UBOOTTOOLS:imx-generic-bsp = "u-boot-summit-tools"

DDR_FIRMWARE_VERSION = "202409"
DDR_FIRMWARE_NAME = " \
    lpddr5_dmem_v${DDR_FIRMWARE_VERSION}.bin \
    lpddr5_dmem_qb_v${DDR_FIRMWARE_VERSION}.bin \
    lpddr5_imem_v${DDR_FIRMWARE_VERSION}.bin \
    lpddr5_imem_qb_v${DDR_FIRMWARE_VERSION}.bin \
"

SPL_BINARY = "spl/u-boot-spl.bin"

ATF_PLATFORM = "imx95"

OEI_CONFIGS = "ddr tcm"
OEI_CORE   = "m33"
OEI_SOC    = "mx95"
OEI_BOARD  = "mx95lp5"
OEI_DDR_CONFIG = "NITROGEN_IMX95_LPDDR5_6400MTS_timing"
OEI_DDRCONFIG = "${OEI_DDR_CONFIG}"
OEI_DDR_CONFIG_ECC = "NITROGEN_IMX95_LPDDR5_6400MTS_ecc_timing"

DDR_TYPE   = "lpddr5"

SYSTEM_MANAGER_CONFIG = "mx95evk"

SERIAL_CONSOLES = "115200;ttyLP0"

LOADADDR = ""
UBOOT_SUFFIX = "img"
UBOOT_BINARY = "flash.bin"
UBOOT_MAKE_TARGET = "all"
IMX_BOOT_SEEK = "32"

MACHINE_EXTRA_RDEPENDS += "${MACHINE_FIRMWARE}"
EXTRA_IMAGEDEPENDS += "virtual/bootloader"

SOC_HAS_VIVANTE_KERNEL_DRIVER_SUPPORT:imxgpu = "0"

IMX_DEFAULT_BSP = "nxp"

# Keep the SDK host variant on upstream QEMU; target QEMU remains i.MX-pinned.
PREFERRED_VERSION_nativesdk-qemu:mx95-nxp-bsp = "8.2%"

MACHINE_EXTRA_RRECOMMENDS:remove = "imx-m33-demos"  

KERNEL_CLASSES = "kernel-fit-extra-artifacts"
KERNEL_IMAGETYPES = "Image"

KERNEL_IMAGETYPE = "Image"
KERNEL_IMAGETYPE:mx9-generic-bsp = "Image"
IMAGE_CLASSES += "dm-verity"

UBOOT_LOADADDRESS = "0x92000000"
UBOOT_ENTRYPOINT:mx95-generic-bsp = "0x92000000"
UBOOT_DTB_LOADADDRESS = "0x95000000"
UBOOT_DTBO_LOADADDRESS = "0x95080000"
UBOOT_RD_LOADADDRESS = "0x96000000"

FIT_KERNEL_COMP_ALG = "zstd"
FIT_KERNEL_COMP_ALG_EXTENSION = ".zst"

FIT_PAD_ALG = "pss"
FIT_HASH_ALG = "sha256"
FIT_SIGN_ALG = "rsa2048"

UBOOT_SIGN_KEYDIR = "${SIG_DATA_PATH}/keys"
SIG_DATA_PATH ?= "${SUMMIT_SOM_KEYS_DIR}/nitrogen/ahab"
UBOOT_SIGN_KEYNAME = "dev"
UBOOT_SIGN_ENABLE = "1"

UBOOT_ENV_OFFSET = "4128768"
EMMC_BOOT_OFFSET = "0"
EMMC_DEVICE = "0"
SD_DEVICE = "1"
```

## conf/machine/include/mt83xx-tungsten.inc
```bitbake
#@TYPE: Machine
#@NAME: Tungsten 510 and 700
#@SOC: Genio 510, 700
#@DESCRIPTION: Machine configuration for Tungsten 510 and 700
#@MAINTAINER: Boris Krasnovskiy <Boris.Krasnovskiy@ezurio.com>

require conf/machine/include/arm/arch-armv8a.inc
require conf/machine/include/soc-family.inc
require conf/machine/include/mediatek-common.inc

PREFERRED_VERSION_hwdata = "0.393"
PREFERRED_VERSION_hwdata-native = "0.393"
PREFERRED_VERSION_libdisplay-info = "0.2.0"
PREFERRED_VERSION_wayland = "1.24.0"
PREFERRED_VERSION_wayland-native = "1.24.0"
PREFERRED_VERSION_wayland-protocols = "1.47"
PREFERRED_VERSION_wayland-protocols-native = "1.47"
PREFERRED_VERSION_wayland-utils = "1.3.0"
PREFERRED_VERSION_weston = "15.0.1"

PREFERRED_PROVIDER_virtual/dtb:remove = "dtbo"

# for better sstate cache reuse
DEFAULTTUNE = "armv8a-crc-crypto"

SOC_SRAM_ADDR = "0x201000"

# Trusted Firmware-A
TFA_PLATFORM = "mt8188"

# OP-TEE
OPTEE_TARGET = "mediatek-mt8370"
# OP-TEE DRAM size (backup value only)
OPTEE_DRAM_SIZE = "0x100000000"

# LK
LK_PROJECT = "mt8390-evk"

MACHINE_FEATURES:summitsom = "usbgadget usbhost alsa rtc  screen touchscreen wifi bluetooth camera \
	${@bb.utils.contains('NDA_BUILD', '1', 'optee-efuse', '', d)}"

# Mali
require conf/machine/include/gpu-provider.inc
MALI_SOC = "mt8188"

MACHINE_EXTRA_RRECOMMENDS:append = " \
	linux-firmware-mt8188-scp \
	linux-firmware-mt8188-sof \
	kernel-module-mtk-vcu-driver-mt8365 \
	kernel-module-mtk-vcodec-driver-mt8365 \
	${@bb.utils.contains("MACHINE_FEATURES", "optee-efuse", "optee-ewriter", "", d)} \
"

MACHINEOVERRIDES =. "summitsom-genio:summitsom:"

require conf/machine/include/u-boot-summit.inc

PREFERRED_PROVIDER_u-boot = "u-boot-summit-mt83xx"
PREFERRED_PROVIDER_virtual/bootloader = "u-boot-summit-mt83xx"
PREFERRED_PROVIDER_u-boot:summitsom-usb-boot = "u-boot-summit-mt83xx-da"
PREFERRED_PROVIDER_virtual/bootloader:summitsom-usb-boot = "u-boot-summit-mt83xx-da"

include ${@bb.utils.contains('BBFILE_COLLECTIONS', 'summit-radio', 'conf/machine/include/radio-stack.inc', '', d)}

MACHINE_FEATURES = "usbgadget usbhost alsa rtc optee screen touchscreen wifi bluetooth camera"

# libdram
LIBDRAM_BOARD_NAME = "genio-700-evk"

# LK
LK_PROJECT = "mt8390-evk"
LK_BOARD_NAME = "${LK_PROJECT}"

SERIAL_CONSOLES = "115200;ttyS0"

MACHINE_ESSENTIAL_EXTRA_RDEPENDS = ""

EXTRA_IMAGEDEPENDS = "virtual/bl2:do_deploy virtual/bl3:do_deploy virtual/bootloader:do_deploy"

IMAGE_FSTYPES = ""

IMAGE_CLASSES += "dm-verity"

FIT_KERNEL_COMP_ALG = "zstd"
FIT_KERNEL_COMP_ALG_EXTENSION = ".zst"

FIT_PAD_ALG = "pss"
FIT_HASH_ALG = "sha256"
FIT_SIGN_ALG = "rsa3072"

KERNEL_CLASSES = "kernel-fit-extra-artifacts"
KERNEL_IMAGETYPE = "Image"
KERNEL_IMAGETYPES = "Image"
IMAGE_BOOT_FILES = "bl2.img fip.bin uboot.env"
SWUPDATE_IMAGES = "bl2.img fip.bin uboot.env"

CUSTOM_KEYS_DIR ?= ""

UBOOT_SIGN_ENABLE = "1"
UBOOT_SIGN_KEYNAME = "dev"
UBOOT_SIGN_KEYDIR = "${@oe.utils.conditional('CUSTOM_KEYS_DIR', '', '${SUMMIT_SOM_KEYS_DIR}/tungsten', '${CUSTOM_KEYS_DIR}', d)}"
DEFAULT_EFUSE_KEY = "${SUMMIT_SOM_KEYS_DIR}/tungsten/dev.key"
SECURE_BOOT_ROT_KEY ?= "${SUMMIT_SOM_KEYS_DIR}/tungsten/dev.key"
BL2_SIGN_ENABLE = "${SECURE_BOOT}"
DA_SIGN_ENABLE = "${SECURE_BOOT}"

FIT_KERNEL_SIGN_ENABLE = "${UBOOT_SIGN_ENABLE}"
FIT_KERNEL_SIGN_KEYNAME = "${UBOOT_SIGN_KEYNAME}"
FIT_KERNEL_SIGN_KEYDIR = "${UBOOT_SIGN_KEYDIR}"

UBOOT_ENV_OFFSET = "4145152"
FIP_OFFSET = "409600"
EMMC_DEVICE = "0"
SD_DEVICE = "1"

SUMMIT_SOM_RADIO_TYPE ??= "mt320"
```

## conf/machine/include/u-boot-summit.inc
```bitbake
PREFERRED_PROVIDER_u-boot-tools = "u-boot-summit-tools"
PREFERRED_PROVIDER_u-boot-tools-native = "u-boot-summit-tools-native"
PREFERRED_PROVIDER_nativesdk-u-boot-tools = "nativesdk-u-boot-summit-tools"

PREFERRED_PROVIDER_u-boot-mkimage = "u-boot-summit-tools"
PREFERRED_PROVIDER_u-boot-mkimage-native = "u-boot-summit-tools-native"
PREFERRED_PROVIDER_nativesdk-u-boot-mkimage = "nativesdk-u-boot-summit-tools"

PREFERRED_PROVIDER_u-boot-mkenvimage = "u-boot-summit-tools"
PREFERRED_PROVIDER_u-boot-mkenvimage-native = "u-boot-summit-tools-native"
PREFERRED_PROVIDER_nativesdk-u-boot-mkenvimage = "nativesdk-u-boot-summit-tools"

PREFERRED_PROVIDER_u-boot-mkeficapsule = "u-boot-summit-tools"
PREFERRED_PROVIDER_u-boot-mkeficapsule-native = "u-boot-summit-tools-native"
PREFERRED_PROVIDER_nativesdk-u-boot-mkeficapsule = "nativesdk-u-boot-summit-tools"

PREFERRED_PROVIDER_u-boot-dumpimage = "u-boot-summit-tools"
PREFERRED_PROVIDER_u-boot-dumpimage-native = "u-boot-summit-tools-native"
PREFERRED_PROVIDER_nativesdk-u-boot-dumpimage = "nativesdk-u-boot-summit-tools"
PREFERRED_RPROVIDER_u-boot-dumpimage = "u-boot-summit-tools-dumpimage"
```

## conf/machine/mt8370-tungsten-smarc.conf
```bitbake
require conf/machine/include/mt83xx-tungsten.inc

MACHINEOVERRIDES =. "genio-510:summitsom_smarc:"

SOC_FAMILY = "mt8370"

UBOOT_MACHINE = "tungsten_mt8370_defconfig"

SUMMIT_DEVICE_TREE_FILES = " \
        tungsten-mt8370-smarc-dvk.dts \
        tungsten-mt8370-smarc-apusys.dtso \
        tungsten-mt8370-smarc-csi0-ov5640.dtso \
        tungsten-mt8370-smarc-csi0-ov5645.dtso \
        tungsten-mt8370-smarc-csi0-pivariety.dtso \
        tungsten-mt8370-smarc-csi1-ov5640.dtso \
        tungsten-mt8370-smarc-csi1-ov5645.dtso \
        tungsten-mt8370-smarc-csi1-pivariety.dtso \
        tungsten-mt8370-smarc-hdmi.dtso \
        tungsten-mt8370-smarc-dp.dtso \
        tungsten-mt8370-smarc-edp.dtso \
        tungsten-mt8370-smarc-dsi0-10.dtso \
        tungsten-mt8370-smarc-dsi0-7.dtso \
        tungsten-mt8370-smarc-m2-60-sdio-sdio.dtso \
        tungsten-mt8370-smarc-m2-60-sdio-uart.dtso \
        tungsten-mt8370-smarc-m2-ifx-sdio.dtso \
        tungsten-mt8370-smarc-m2-nx6xx-sdio.dtso \
        tungsten-mt8370-smarc-m2-pcie.dtso \
        tungsten-mt8370-smarc-m2-ti3xx-sdio.dtso \
        tungsten-mt8370-smarc-video.dtso \
        tungsten-mt8370-smarc-wifi-ifx.dtso \
        tungsten-mt8370-smarc-wifi-mt320.dtso \
        tungsten-mt8370-smarc-wifi-nx6xx.dtso \
        tungsten-mt8370-smarc-wifi-ti3xx.dtso \
"

FIT_CONF_DEFAULT_DTB = "tungsten-mt8370-smarc-dvk.dtb"

SUMMIT_SOM_RADIO_TYPE ?= "dvk-combo"
BT_SERIAL_PORT = "/dev/ttyS1"
```

## conf/machine/mt8390-tungsten-smarc.conf
```bitbake
require conf/machine/include/mt83xx-tungsten.inc

MACHINEOVERRIDES =. "mt8390:genio-700:summitsom_smarc:"

SOC_FAMILY = "mt8188"

UBOOT_MACHINE = "tungsten_mt8390_defconfig"

SUMMIT_DEVICE_TREE_FILES = " \
        tungsten-mt8390-smarc-dvk.dts \
        tungsten-mt8390-smarc-apusys.dtso \
        tungsten-mt8390-smarc-csi0-ov5640.dtso \
        tungsten-mt8390-smarc-csi0-ov5645.dtso \
        tungsten-mt8390-smarc-csi0-pivariety.dtso \
        tungsten-mt8390-smarc-csi1-ov5640.dtso \
        tungsten-mt8390-smarc-csi1-ov5645.dtso \
        tungsten-mt8390-smarc-csi1-pivariety.dtso \
        tungsten-mt8390-smarc-hdmi.dtso \
        tungsten-mt8390-smarc-dp.dtso \
        tungsten-mt8390-smarc-edp.dtso \
        tungsten-mt8390-smarc-dsi0-10.dtso \
        tungsten-mt8390-smarc-dsi0-7.dtso \
        tungsten-mt8390-smarc-m2-60-sdio-sdio.dtso \
        tungsten-mt8390-smarc-m2-60-sdio-uart.dtso \
        tungsten-mt8390-smarc-m2-ifx-sdio.dtso \
        tungsten-mt8390-smarc-m2-nx6xx-sdio.dtso \
        tungsten-mt8390-smarc-m2-pcie.dtso \
        tungsten-mt8390-smarc-m2-ti3xx-sdio.dtso \
        tungsten-mt8390-smarc-video.dtso \
        tungsten-mt8390-smarc-wifi-ifx.dtso \
        tungsten-mt8390-smarc-wifi-mt320.dtso \
        tungsten-mt8390-smarc-wifi-nx6xx.dtso \
        tungsten-mt8390-smarc-wifi-ti3xx.dtso \
"

FIT_CONF_DEFAULT_DTB = "tungsten-mt8390-smarc-dvk.dtb"

SUMMIT_SOM_RADIO_TYPE ?= "dvk-combo"
BT_SERIAL_PORT = "/dev/ttyS1"
```

## defconfig
```kconfig
CONFIG_ARM=y
CONFIG_SYS_BOARD="genio-700-evk"
CONFIG_COUNTER_FREQUENCY=13000000
CONFIG_POSITION_INDEPENDENT=y
CONFIG_ARCH_MEDIATEK=y
CONFIG_SYS_TEXT_BASE=0x4c000000
CONFIG_SYS_MALLOC_LEN=0x500000
CONFIG_SYS_MALLOC_F_LEN=0x4000
CONFIG_NR_DRAM_BANKS=1
CONFIG_ENV_SIZE=0x2000
CONFIG_ENV_OFFSET=0x3f0000
CONFIG_DM_GPIO=y
CONFIG_DEFAULT_DEVICE_TREE="genio-700-evk"
CONFIG_TARGET_MT8188=y
CONFIG_DEBUG_UART_BASE=0x11001100
CONFIG_DEBUG_UART_CLOCK=26000000
CONFIG_ARMV8_CRYPTO=y
CONFIG_SYS_LOAD_ADDR=0x4c000000
CONFIG_DEBUG_UART=y
CONFIG_LTO=y
CONFIG_ENV_VARS_UBOOT_CONFIG=y
CONFIG_FIT=y
CONFIG_FIT_SIGNATURE=y
CONFIG_FIT_RSASSA_PSS=y
# CONFIG_FIT_PRINT is not set
# CONFIG_BOOTSTD is not set
CONFIG_LEGACY_IMAGE_FORMAT=y
# CONFIG_ARCH_FIXUP_FDT_MEMORY is not set
CONFIG_BOOTARGS_SUBST=y
CONFIG_DEFAULT_FDT_FILE="mt8390-genio-700-evk"
CONFIG_CONSOLE_MUX=y
CONFIG_SYS_STDIO_DEREGISTER=y
# CONFIG_DISPLAY_BOARDINFO is not set
CONFIG_EVENT=y
CONFIG_EVENT_DYNAMIC=y
CONFIG_BOARD_LATE_INIT=y
CONFIG_HUSH_PARSER=y
# CONFIG_CMD_CONSOLE is not set
# CONFIG_CMD_BOOTD is not set
# CONFIG_CMD_BOOTI is not set
# CONFIG_BOOTM_NETBSD is not set
# CONFIG_BOOTM_PLAN9 is not set
# CONFIG_BOOTM_RTEMS is not set
# CONFIG_BOOTM_VXWORKS is not set
CONFIG_SYS_BOOTM_LEN=0x5000000
# CONFIG_CMD_BOOTEMBEDDED is not set
# CONFIG_CMD_ELF is not set
# CONFIG_CMD_FDT is not set
# CONFIG_CMD_DTBPROBE is not set
# CONFIG_CMD_GO is not set
# CONFIG_CMD_IMI is not set
# CONFIG_CMD_XIMG is not set
# CONFIG_CMD_EXPORTENV is not set
# CONFIG_CMD_IMPORTENV is not set
CONFIG_CMD_NVEDIT_INFO=y
# CONFIG_CMD_CRC32 is not set
CONFIG_CMD_CLK=y
CONFIG_CMD_GPIO=y
CONFIG_CMD_I2C=y
# CONFIG_CMD_LOADB is not set
# CONFIG_CMD_LOADS is not set
CONFIG_CMD_MMC=y
CONFIG_CMD_PART=y
# CONFIG_CMD_PINMUX is not set
CONFIG_CMD_POWEROFF=y
# CONFIG_CMD_ITEST is not set
# CONFIG_CMD_BLOCK_CACHE is not set
CONFIG_CMD_FS_GENERIC=y
CONFIG_DOS_PARTITION=y
CONFIG_EFI_PARTITION=y
CONFIG_ENV_OVERWRITE=y
CONFIG_ENV_IS_NOWHERE=y
CONFIG_ENV_IS_IN_MMC=y
CONFIG_SYS_RELOC_GD_ENV_ADDR=y
CONFIG_ENV_IMPORT_FDT=y
CONFIG_ENV_WRITEABLE_LIST=y
# CONFIG_NET is not set
CONFIG_DM_EVENT=y
CONFIG_REGMAP=y
CONFIG_SYSCON=y
CONFIG_DEVRES=y
CONFIG_ADC=y
CONFIG_ADC_MTK=y
CONFIG_CLK=y
CONFIG_GPIO_HOG=y
CONFIG_DM_I2C=y
CONFIG_SYS_I2C_MTK=y
# CONFIG_INPUT is not set
CONFIG_MISC=y
# CONFIG_MMC_QUIRKS is not set
CONFIG_SUPPORT_EMMC_BOOT=y
CONFIG_MMC_HS400_SUPPORT=y
CONFIG_MMC_MTK=y
CONFIG_PHY=y
CONFIG_PHY_MTK_TPHY=y
CONFIG_PINCTRL=y
CONFIG_PINCONF=y
CONFIG_PINCTRL_MT8188=y
CONFIG_POWER_DOMAIN=y
CONFIG_MTK_POWER_DOMAIN=y
CONFIG_DM_PMIC=y
CONFIG_MTK_PMIC_WRAP=y
CONFIG_DM_REGULATOR=y
CONFIG_DM_REGULATOR_FIXED=y
CONFIG_DM_REGULATOR_MT6359=y
CONFIG_BAUDRATE=921600
CONFIG_DM_SERIAL=y
CONFIG_DEBUG_UART_ANNOUNCE=y
CONFIG_MTK_SERIAL=y
CONFIG_SYSRESET=y
CONFIG_SYSRESET_PSCI=y
CONFIG_WDT=y
CONFIG_FS_FAT=y
CONFIG_REGEX=y
# CONFIG_GZIP is not set
CONFIG_ZSTD=y
CONFIG_OF_LIBFDT_OVERLAY=y
# CONFIG_EFI_LOADER is not set
CONFIG_LMB_MAX_REGIONS=16
```

## recipes-support/swupdate/swupdate/summitsom/defconfig
```kconfig
CONFIG_HW_COMPATIBILITY=y
CONFIG_HW_COMPATIBILITY_FILE="/run/hwrevision"
CONFIG_SW_VERSIONS_FILE="/run/sw-version"
CONFIG_SOCKET_CTRL_PATH="/tmp/sockinstctrl"
CONFIG_SOCKET_PROGRESS_PATH="/tmp/swupdateprog"
# CONFIG_MTD is not set
# CONFIG_LUA is not set
CONFIG_UBOOT=y
CONFIG_HASH_VERIFY=y
# CONFIG_WEBSERVER is not set
CONFIG_ZSTD=y
CONFIG_BOOTLOADERHANDLER=y
CONFIG_RAW=y
CONFIG_SHELLSCRIPTHANDLER=y
```
