## conf/machine/imx93-nitrogen-osm-m.conf
```bitbake
#@TYPE: Machine
#@NAME: Nitrogen i.MX93
#@SOC: i.MX93
#@DESCRIPTION: Machine configuration for Nitrogen i.MX93
#@MAINTAINER: Boris Krasnovskiy <Boris.Krasnovskiy@ezurio.com>

require conf/machine/include/imx93-nitrogen.inc

MACHINEOVERRIDES =. "summitsom_osm:"

KERNEL_DEVICETREE_BASENAME = "nitrogen-imx93-osm-m"

KERNEL_DEVICETREE = " \
    freescale/nitrogen-imx93-osm-m-dvk.dtb \
    freescale/nitrogen-imx93-osm-m-csi-a-ov5640.dtbo \
    freescale/nitrogen-imx93-osm-m-csi-a-ov5645.dtbo \
    freescale/nitrogen-imx93-osm-m-dsi0-10.dtbo \
    freescale/nitrogen-imx93-osm-m-dsi0-7.dtbo \
    freescale/nitrogen-imx93-osm-m-ethosu.dtbo \
    freescale/nitrogen-imx93-osm-m-lvds-d-10.dtbo \
    freescale/nitrogen-imx93-osm-m-lvds-d-7.dtbo \
    freescale/nitrogen-imx93-osm-m-lvds-d-hdmi.dtbo \
    freescale/nitrogen-imx93-osm-m-m2-60-sdio-sdio.dtbo \
    freescale/nitrogen-imx93-osm-m-m2-60-sdio-uart.dtbo \
    freescale/nitrogen-imx93-osm-m-m2-ifx-sdio.dtbo \
    freescale/nitrogen-imx93-osm-m-m2-nx6xx-sdio.dtbo \
    freescale/nitrogen-imx93-osm-m-m2-ti3xx-sdio.dtbo \
    freescale/nitrogen-imx93-osm-m-m2-usb.dtbo \
    freescale/nitrogen-imx93-osm-m-mcu.dtbo \
    freescale/nitrogen-imx93-osm-m-wifi-ifx.dtbo \
    freescale/nitrogen-imx93-osm-m-wifi-nx6xx.dtbo \
    freescale/nitrogen-imx93-osm-m-wifi-ti3xx.dtbo \
"

FIT_CONF_DEFAULT_DTB = "nitrogen-imx93-osm-m-dvk.dtb"

UBOOT_MACHINE = "nitrogen_imx93_osm_m_defconfig"

SUMMIT_SOM_RADIO_TYPE ?= "dvk-combo"
BT_SERIAL_PORT = "/dev/ttyLP4"
```

## conf/machine/imx93-nitrogen-osm-s.conf
```bitbake
#@TYPE: Machine
#@NAME: Nitrogen i.MX93
#@SOC: i.MX93
#@DESCRIPTION: Machine configuration for Nitrogen i.MX93
#@MAINTAINER: Boris Krasnovskiy <Boris.Krasnovskiy@ezurio.com>

require conf/machine/include/imx93-nitrogen.inc

MACHINEOVERRIDES =. "summitsom_osm:"

KERNEL_DEVICETREE_BASENAME = "nitrogen-imx93-osm-s"

KERNEL_DEVICETREE = " \
	freescale/nitrogen-imx93-osm-s-dvk.dtb \
	freescale/nitrogen-imx93-osm-s-m2-60-sdio-sdio.dtbo \
	freescale/nitrogen-imx93-osm-s-m2-60-sdio-uart.dtbo \
	freescale/nitrogen-imx93-osm-s-m2-ifx-sdio.dtbo \
	freescale/nitrogen-imx93-osm-s-m2-nx6xx-sdio.dtbo \
	freescale/nitrogen-imx93-osm-s-m2-ti3xx-sdio.dtbo \
	freescale/nitrogen-imx93-osm-s-wifi-ifx.dtbo \
	freescale/nitrogen-imx93-osm-s-wifi-nx6xx.dtbo \
	freescale/nitrogen-imx93-osm-s-wifi-ti3xx.dtbo \
"

FIT_CONF_DEFAULT_DTB = "nitrogen-imx93-osm-s-dvk.dtb"

UBOOT_MACHINE = "nitrogen_imx93_osm_s_defconfig"

SUMMIT_SOM_RADIO_TYPE ?= "dvk-combo"
BT_SERIAL_PORT = "/dev/ttyLP3"
```

## conf/machine/imx93-nitrogen-smarc.conf
```bitbake
#@TYPE: Machine
#@NAME: Nitrogen i.MX93
#@SOC: i.MX93
#@DESCRIPTION: Machine configuration for Nitrogen i.MX93
#@MAINTAINER: Boris Krasnovskiy <Boris.Krasnovskiy@ezurio.com>

require conf/machine/include/imx93-nitrogen.inc

MACHINEOVERRIDES =. "summitsom_smarc:"

SUMMIT_DEVICE_TREE_FILES = " \
        nitrogen-imx93-smarc-dvk.dts \
        nitrogen-imx93-smarc-csi0-ov5640.dtso \
        nitrogen-imx93-smarc-csi0-ov5645.dtso \
        nitrogen-imx93-smarc-dsi0-10.dtso \
        nitrogen-imx93-smarc-dsi0-7.dtso \
        nitrogen-imx93-smarc-ethosu.dtso \
        nitrogen-imx93-smarc-lvds1-10.dtso \
        nitrogen-imx93-smarc-lvds1-7.dtso \
        nitrogen-imx93-smarc-m2-60-sdio-sdio.dtso \
        nitrogen-imx93-smarc-m2-60-sdio-uart.dtso \
        nitrogen-imx93-smarc-m2-ifx-sdio.dtso \
        nitrogen-imx93-smarc-m2-nx6xx-sdio.dtso \
        nitrogen-imx93-smarc-m2-ti3xx-sdio.dtso \
        nitrogen-imx93-smarc-mcu.dtso \
        nitrogen-imx93-smarc-spi-slave.dtso \
        nitrogen-imx93-smarc-wifi-ifx.dtso \
        nitrogen-imx93-smarc-wifi-nx6xx.dtso \
        nitrogen-imx93-smarc-wifi-ti3xx.dtso \
"

FIT_CONF_DEFAULT_DTB = "nitrogen-imx93-smarc-dvk.dtb"

UBOOT_MACHINE = "nitrogen_imx93_smarc_defconfig"

SUMMIT_SOM_RADIO_TYPE ?= "dvk-combo"
BT_SERIAL_PORT = "/dev/ttyLP7"
```

## conf/machine/imx95-nitrogen-smarc.conf
```bitbake
#@TYPE: Machine
#@NAME: Nitrogen i.MX95
#@SOC: i.MX95
#@DESCRIPTION: Machine configuration for Nitrogen i.MX95 SMARC module
#@MAINTAINER: Boris Krasnovskiy <Boris.Krasnovskiy@ezurio.com>

require conf/machine/include/imx95-nitrogen.inc

MACHINEOVERRIDES =. "summitsom_smarc:"

SUMMIT_DEVICE_TREE_FILES = " \
        nitrogen-imx95-smarc-dvk.dts \
        nitrogen-imx95-smarc-csi0-ov5640.dtso \
        nitrogen-imx95-smarc-csi0-ov5645.dtso \
        nitrogen-imx95-smarc-csi0-pivariety.dtso \
        nitrogen-imx95-smarc-csi1-ov5640.dtso \
        nitrogen-imx95-smarc-csi1-ov5645.dtso \
        nitrogen-imx95-smarc-csi1-pivariety.dtso \
        nitrogen-imx95-smarc-dsi0-10.dtso \
        nitrogen-imx95-smarc-dsi0-7.dtso \
        nitrogen-imx95-smarc-lvds0-10.dtso \
        nitrogen-imx95-smarc-lvds0-7.dtso \
        nitrogen-imx95-smarc-lvds1-10.dtso \
        nitrogen-imx95-smarc-lvds1-7.dtso \
        nitrogen-imx95-smarc-m2-60-sdio-sdio.dtso \
        nitrogen-imx95-smarc-m2-60-sdio-uart.dtso \
        nitrogen-imx95-smarc-m2-ifx-sdio.dtso \
        nitrogen-imx95-smarc-m2-nx6xx-sdio.dtso \
        nitrogen-imx95-smarc-m2-pcie.dtso \
        nitrogen-imx95-smarc-m2-ti3xx-sdio.dtso \
        nitrogen-imx95-smarc-mcu.dtso \
        nitrogen-imx95-smarc-nutron.dtso \
        nitrogen-imx95-smarc-wifi-ifx.dtso \
        nitrogen-imx95-smarc-wifi-nx6xx.dtso \
        nitrogen-imx95-smarc-wifi-ti3xx.dtso \
"

FIT_CONF_DEFAULT_DTB = "nitrogen-imx95-smarc-dvk.dtb"

UBOOT_MACHINE = "nitrogen_imx95_defconfig"

SUMMIT_SOM_RADIO_TYPE ?= "dvk-combo"
BT_SERIAL_PORT = "/dev/ttyLP7"
```

## conf/machine/include/am62lx-carbon.inc
```bitbake
#@TYPE: Machine
#@NAME: Carbon AM62Lx
#@SOC: AM62Lx
#@DESCRIPTION: Machine configuration for Carbon AM62Lx
#@MAINTAINER: Boris Krasnovskiy <Boris.Krasnovskiy@ezurio.com>

MACHINEOVERRIDES =. "summitsom:"

# for better sstate cache reuse
DEFAULTTUNE = "armv8a-crc-crypto"

TFA_BOARD = "am62lx"

require conf/machine/include/u-boot-summit.inc
include ${@bb.utils.contains('BBFILE_COLLECTIONS', 'summit-radio', 'conf/machine/include/radio-stack.inc', '', d)}

MACHINE_FEATURES = "usbgadget usbhost alsa rtc optee screen touchscreen wifi bluetooth nand"

TI_PREFERRED_BSP = "ti-6_18"

SERIAL_CONSOLES = "115200;ttyS2"

MACHINE_ESSENTIAL_EXTRA_RDEPENDS = ""
EXTRA_IMAGEDEPENDS = "virtual/bootloader"

IMAGE_FSTYPES = ""

IMAGE_CLASSES += "dm-verity"

FIT_KERNEL_COMP_ALG = "zstd"
FIT_KERNEL_COMP_ALG_EXTENSION = ".zst"

FIT_PAD_ALG = "pss"
FIT_HASH_ALG = "sha512"
FIT_SIGN_ALG = "rsa4096"

KERNEL_IMAGETYPE = "Image"
KERNEL_IMAGETYPES = "Image"
IMAGE_BOOT_FILES = "${SPL_BINARYNAME} u-boot.${UBOOT_SUFFIX} tiboot3.bin uboot.env prov_data.tar.gz_sign_enc.bin"
SWUPDATE_IMAGES = "${SPL_BINARYNAME} u-boot.${UBOOT_SUFFIX} tiboot3.bin uboot.env prov_data.tar.gz_sign_enc.bin"

CUSTOM_KEYS_DIR ?= ""

UBOOT_SIGN_ENABLE = "1"
UBOOT_SIGN_KEYNAME = "dev"
UBOOT_SIGN_KEYDIR = "${@oe.utils.conditional('CUSTOM_KEYS_DIR', '', '${SUMMIT_SOM_KEYS_DIR}/carbon', '${CUSTOM_KEYS_DIR}', d)}"

FIT_KERNEL_SIGN_ENABLE = "${UBOOT_SIGN_ENABLE}"
FIT_KERNEL_SIGN_KEYNAME = "${UBOOT_SIGN_KEYNAME}"
FIT_KERNEL_SIGN_KEYDIR = "${UBOOT_SIGN_KEYDIR}"

UBOOT_ENV_OFFSET = "3670016"
EMMC_SPL_OFFSET = "524288"
EMMC_BOOT_OFFSET = "2621440"
EMMC_DEVICE = "0"
SD_DEVICE = "1"

BT_SERIAL_PORT = "/dev/ttyS5"
```

## conf/machine/include/carbon-summitsom.inc
```bitbake
require conf/machine/include/u-boot-summit.inc
include ${@bb.utils.contains('BBFILE_COLLECTIONS', 'summit-radio', 'conf/machine/include/radio-stack.inc', '', d)}

DEFAULTTUNE:k3 ?= "armv8a-crc-crypto"

MACHINEOVERRIDES =. "summitsom:"

TI_PREFERRED_BSP = "ti-6_12"

BSP_BOOTLOADER_PROVIDER:bsp-ti-6_12 = "u-boot-ti-summit"
BSP_BOOTLOADER_VERSION:bsp-ti-6_12 = "%"

IMAGE_FSTYPES = ""

IMAGE_CLASSES += "dm-verity"

SWUPDATE_IMAGES = "\
    ${SPL_BINARYNAME} \
    u-boot.${UBOOT_SUFFIX} \
    tiboot3.bin \
    uboot.env \
    prov_data.tar.gz_sign_enc.bin \
    "

FIT_KERNEL_COMP_ALG = "zstd"
FIT_KERNEL_COMP_ALG_EXTENSION = ".zst"

FIT_PAD_ALG = "pss"
FIT_HASH_ALG = "sha512"
FIT_SIGN_ALG = "rsa4096"

CUSTOM_KEYS_DIR ?= ""
UBOOT_SIGN_KEYDIR = "${@oe.utils.conditional('CUSTOM_KEYS_DIR', '', '${SUMMIT_SOM_KEYS_DIR}/carbon', '${CUSTOM_KEYS_DIR}', d)}"
UBOOT_SIGN_KEYNAME = "dev"

# Do not set these for k3r5
UBOOT_SIGN_ENABLE:k3 = "1"
KERNEL_CLASSES = "kernel-fit-extra-artifacts"
KERNEL_IMAGETYPE:k3 = "Image"
KERNEL_IMAGETYPES:k3 = "Image"
IMAGE_BOOT_FILES:k3 = "${SPL_BINARYNAME} u-boot.${UBOOT_SUFFIX} tiboot3.bin uboot.env prov_data.tar.gz_sign_enc.bin"

MACHINE_ESSENTIAL_EXTRA_RDEPENDS:remove = "kernel-image-image kernel-devicetree"

MACHINE_FEATURES:k3 = "usbgadget usbhost vfat ext2 alsa optee rtc screen wifi bluetooth" 

MACHINE_FEATURES:k3r5 = ""

# It's needed to equalize hash for tclib-baremetal with tclib-glibc
# and as such have sstate cache reuse for native recipies
CXXFLAGS:append:k3r5 = " -fvisibility-inlines-hidden"

UBOOT_ENV_OFFSET = "3670016"
EMMC_SPL_OFFSET = "524288"
EMMC_BOOT_OFFSET = "2621440"

EMMC_DEVICE = "0"
SD_DEVICE = "1"

SERIAL_CONSOLES = "115200;ttyS2"
```

## conf/machine/include/imx91-nitrogen.inc
```bitbake
#@TYPE: Machine
#@NAME: Nitrogen i.MX91
#@SOC: i.MX91
#@DESCRIPTION: Machine configuration for Nitrogen i.MX91
#@MAINTAINER: Boris Krasnovskiy <Boris.Krasnovskiy@ezurio.com>

MACHINEOVERRIDES =. "mx91:summitsom:ahab:"

require conf/machine/include/imx-base.inc
require conf/machine/include/arm/armv8-2a/tune-cortexa55.inc

# for better sstate cache reuse
DEFAULTTUNE:mx91-generic-bsp = "armv8a-crc-crypto"

require conf/machine/include/u-boot-summit.inc
include ${@bb.utils.contains('BBFILE_COLLECTIONS', 'summit-radio', 'conf/machine/include/radio-stack.inc', '', d)}

MACHINE_FEATURES = "usbgadget usbhost alsa rtc optee wifi bluetooth"

SOC_DEFAULT_IMAGE_FSTYPES = ""

IMAGE_BOOT_FILES = "uboot.env"
SWUPDATE_IMAGES = "flash.bin uboot.env"

UBOOT_PROVIDES_BOOT_CONTAINER = "1"
IMX_DEFAULT_BOOTLOADER:mx9-generic-bsp = "u-boot-imx-summit"
IMX_DEFAULT_UBOOTTOOLS:imx-generic-bsp = "u-boot-summit-tools"

DDR_FIRMWARE_VERSION = "202201"
DDR_FIRMWARE_NAME = " \
    lpddr4_dmem_1d_v${DDR_FIRMWARE_VERSION}.bin \
    lpddr4_dmem_2d_v${DDR_FIRMWARE_VERSION}.bin \
    lpddr4_imem_1d_v${DDR_FIRMWARE_VERSION}.bin \
    lpddr4_imem_2d_v${DDR_FIRMWARE_VERSION}.bin \
"

SPL_BINARY = "spl/u-boot-spl.bin"

ATF_PLATFORM = "imx91"

SERIAL_CONSOLES = "115200;ttyLP0"

LOADADDR = ""
UBOOT_SUFFIX = "img"
UBOOT_BINARY = "flash.bin"
UBOOT_MAKE_TARGET = "all"
IMX_BOOT_SEEK = "32"

MACHINE_EXTRA_RDEPENDS += "${MACHINE_FIRMWARE}"
EXTRA_IMAGEDEPENDS += "virtual/bootloader"

SOC_HAS_VIVANTE_KERNEL_DRIVER_SUPPORT:imxgpu = "0"

IMX_DEFAULT_BSP = "nxp"

KERNEL_CLASSES = "kernel-fit-extra-artifacts"

KERNEL_IMAGETYPE = "Image"
KERNEL_IMAGETYPE:mx9-generic-bsp = "Image"
IMAGE_CLASSES += "dm-verity"

UBOOT_LOADADDRESS = "0x82000000"
UBOOT_ENTRYPOINT:mx91-generic-bsp = "0x82000000"
UBOOT_DTB_LOADADDRESS = "0x85000000"
UBOOT_DTBO_LOADADDRESS = "0x85080000"
UBOOT_RD_LOADADDRESS = "0x86000000"

FIT_KERNEL_COMP_ALG = "zstd"
FIT_KERNEL_COMP_ALG_EXTENSION = ".zst"

FIT_PAD_ALG = "pss"
FIT_HASH_ALG = "sha256"
FIT_SIGN_ALG = "rsa2048"

SIG_SUPPORT_PATH ?= "${SUMMIT_SOM_KEYS_DIR}/nitrogen/ahab"
SIG_KEY_PATH_LOCAL = "${SIG_SUPPORT_PATH}/keys"
CLOUD_HSM_REQUIRED_ROLES = "AHAB FIT UPDATE"
UBOOT_SIGN_KEYDIR = "${SIG_KEY_PATH}"
UBOOT_SIGN_KEYNAME = "dev"
UBOOT_SIGN_ENABLE = "1"

UBOOT_ENV_OFFSET = "4128768"
EMMC_BOOT_OFFSET = "0"
EMMC_DEVICE = "0"
SD_DEVICE = "1"
```

## conf/machine/include/imx93-nitrogen.inc
```bitbake
#@TYPE: Machine
#@NAME: Nitrogen i.MX93
#@SOC: i.MX93
#@DESCRIPTION: Machine configuration for Nitrogen i.MX93
#@MAINTAINER: Boris Krasnovskiy <Boris.Krasnovskiy@ezurio.com>

MACHINEOVERRIDES =. "mx93:summitsom:ahab:"

require conf/machine/include/imx-base.inc
require conf/machine/include/arm/armv8-2a/tune-cortexa55.inc

# for better sstate cache reuse
DEFAULTTUNE:mx93-generic-bsp = "armv8a-crc-crypto"

require conf/machine/include/u-boot-summit.inc
include ${@bb.utils.contains('BBFILE_COLLECTIONS', 'summit-radio', 'conf/machine/include/radio-stack.inc', '', d)}

MACHINE_FEATURES = "usbgadget usbhost alsa rtc optee screen touchscreen wifi bluetooth camera"
MACHINE_FEATURES:append:use-nxp-bsp = " dpdk ethos-u-firmware"
MACHINE_FEATURES:remove = "nxpaw693-sdio"

SOC_DEFAULT_IMAGE_FSTYPES = ""

IMAGE_BOOT_FILES = "uboot.env"
SWUPDATE_IMAGES = "flash.bin uboot.env"

UBOOT_PROVIDES_BOOT_CONTAINER = "1"
IMX_DEFAULT_BOOTLOADER:mx9-generic-bsp = "u-boot-imx-summit"
IMX_DEFAULT_UBOOTTOOLS:imx-generic-bsp = "u-boot-summit-tools"

DDR_FIRMWARE_VERSION = "202201"
DDR_FIRMWARE_NAME = " \
    lpddr4_dmem_1d_v${DDR_FIRMWARE_VERSION}.bin \
    lpddr4_dmem_2d_v${DDR_FIRMWARE_VERSION}.bin \
    lpddr4_imem_1d_v${DDR_FIRMWARE_VERSION}.bin \
    lpddr4_imem_2d_v${DDR_FIRMWARE_VERSION}.bin \
"

SPL_BINARY = "spl/u-boot-spl.bin"

ATF_PLATFORM = "imx93"

SERIAL_CONSOLES = "115200;ttyLP0"

LOADADDR = ""
UBOOT_SUFFIX = "img"
UBOOT_BINARY = "flash.bin"
UBOOT_MAKE_TARGET = "all"
IMX_BOOT_SEEK = "32"

MACHINE_EXTRA_RDEPENDS += "${MACHINE_FIRMWARE}"
EXTRA_IMAGEDEPENDS += "virtual/bootloader"

SOC_HAS_VIVANTE_KERNEL_DRIVER_SUPPORT:imxgpu = "0"

IMX_DEFAULT_BSP = "nxp"

MACHINE_EXTRA_RRECOMMENDS:remove = "imx-m33-demos"  

KERNEL_CLASSES = "kernel-fit-extra-artifacts"

KERNEL_IMAGETYPE = "Image"
KERNEL_IMAGETYPE:mx9-generic-bsp = "Image"
IMAGE_CLASSES += "dm-verity"

UBOOT_LOADADDRESS = "0x82000000"
UBOOT_ENTRYPOINT:mx93-generic-bsp = "0x82000000"
UBOOT_DTB_LOADADDRESS = "0x85000000"
UBOOT_DTBO_LOADADDRESS = "0x85080000"
UBOOT_RD_LOADADDRESS = "0x86000000"

FIT_KERNEL_COMP_ALG = "zstd"
FIT_KERNEL_COMP_ALG_EXTENSION = ".zst"

FIT_PAD_ALG = "pss"
FIT_HASH_ALG = "sha256"
FIT_SIGN_ALG = "rsa2048"

UBOOT_SIGN_KEYDIR = "${SIG_DATA_PATH}/keys"
SIG_DATA_PATH ?= "${SUMMIT_SOM_KEYS_DIR}/nitrogen/ahab"
UBOOT_SIGN_KEYNAME = "dev"
UBOOT_SIGN_ENABLE = "1"

UBOOT_ENV_OFFSET = "4128768"
EMMC_BOOT_OFFSET = "0"
EMMC_DEVICE = "0"
SD_DEVICE = "1"
```
