// SPDX-License-Identifier: (GPL-2.0+ OR MIT)
/*
 * SDIO NX6xx module
 *
 * Copyright (C) 2026 Ezurio LLC
 */

/dts-v1/;
/plugin/;

// M.2 SDIO is disabled by default on SMARC carrier board
// requires switching 0 Ohm resistors to enable	

&reg_mmc1_en {
	startup-delay-us = <20000>;
	off-on-delay-us = <100>;
};

&mmc1 {
};

&uart1 {
	status = "okay";

	bluetooth {
		compatible = "nxp,88w8987-bt";
		fw-init-baudrate = <3000000>;
		vcc-supply = <&reg_mmc1_en>;
	};
};
