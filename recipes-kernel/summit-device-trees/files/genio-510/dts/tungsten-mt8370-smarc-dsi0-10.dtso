// SPDX-License-Identifier: (GPL-2.0-or-later OR MIT)
/*
 * Copyright 2026 Ezurio LLC
 */

/dts-v1/;
/plugin/;

#include "tungsten-mt8370-smarc-dsi0-7.dtso"

&backlight_dsi0 {
	pwms = <&disp_pwm0 0 100000>;
};

&display_dsi0 {
	width-mm = <217>;
	height-mm = <136>;
};

&touchscreen_dsi0 {
	compatible = "goodix,gt9271";
};
